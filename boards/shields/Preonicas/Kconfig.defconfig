## boards/shields/Preonicas/Kconfig.defconfig
```kconfig
# Copyright (c) 2021 The ZMK Contributors
# SPDX-License-Identifier: MIT

if SHIELD_PREONICAS

config ZMK_KEYBOARD_NAME
    default "Preonicas"

endif
```

## boards/shields/Preonicas/Kconfig.shield
```kconfig
# Copyright (c) 2021 The ZMK Contributors
# SPDX-License-Identifier: MIT

config SHIELD_PREONICAS
    def_bool $(shields_list_contains,Preonicas)
```
